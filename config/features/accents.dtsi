/*
*
* Copyright (c) 2022 Rafael Romão
* SPDX-License-Identifier: MIT
*
*/

#include <behaviors.dtsi>
#include <dt-bindings/zmk/keys.h>
#include <dt-bindings/zmk/bt.h>

/ {
    #define ACCENTED_KEY(NAME, LABEL_U, LABEL_L, LABEL, KEY, DEAD_KEY) \
        ac_##NAME##_l: ac_##NAME##_l { \
            wait-ms = <0>; \
            tap-ms = <0>; \
            label = LABEL_L; \
            compatible = "zmk,behavior-macro"; \
            #binding-cells = <0>; \
            bindings \
                = <&macro_press &kp LALT> \
                , <&macro_tap &kp DEAD_KEY> \
                , <&macro_release &kp LALT> \
                , <&macro_tap &kp KEY> \
                ; \
        }; \
        ac_##NAME##_u: ac_##NAME##_u { \
            wait-ms = <0>; \
            tap-ms = <0>; \
            label = LABEL_U; \
            compatible = "zmk,behavior-macro"; \
            #binding-cells = <0>; \
            bindings \
                = <&macro_release &kp LSHFT> \
                , <&macro_press &kp LALT> \
                , <&macro_tap &kp DEAD_KEY> \
                , <&macro_release &kp LALT> \
                , <&macro_press &kp LSHFT> \
                , <&macro_tap &kp KEY> \
                , <&macro_release &kp LSHFT> \
                ; \
        }; \
        ac_##NAME: ac_##NAME { \
            label = LABEL; \
            compatible = "zmk,behavior-mod-morph"; \
            #binding-cells = <0>; \
            bindings = <&ac_##NAME##_l>, <&ac_##NAME##_u>; \
            mods = <(MOD_LSFT|MOD_RSFT)>; \
            keep-mods = <(MOD_LSFT|MOD_RSFT)>; \
        };

    #define MACRO_HOLD_TAP(NAME, HOLD_MACRO, TAP_MACRO) \
      ht_##NAME: ht_##NAME { \
        compatible = "zmk,behavior-hold-tap"; \
        #binding-cells = <0>; \
        flavor= "tap-preferred"; \
        tapping-term-ms = <150>; \
        bindings = <&HOLD_MACRO>, <&TAP_MACRO>; \
      };

    accents {
        ACCENTED_KEY(agrv, "à", "À", "àÀ", A, GRAVE)
        ACCENTED_KEY(acir, "â", "Â", "âÂ", A, I)
        ACCENTED_KEY(eacu, "é", "É", "éÉ", E, E)
        ACCENTED_KEY(egrv, "è", "È", "èÈ", E, GRAVE)
        ACCENTED_KEY(ecir, "ê", "Ê", "êÊ", E, I)
        ACCENTED_KEY(etre, "ë", "Ë", "ëË", E, U)
        ACCENTED_KEY(icir, "î", "Î", "îÎ", I, I)
        ACCENTED_KEY(itre, "ï", "Ï", "ïÏ", I, U)
        ACCENTED_KEY(ntil, "ñ", "Ñ", "ñÑ", N, N)
        ACCENTED_KEY(ocir, "ô", "Ô", "ôÔ", O, I)
        ACCENTED_KEY(ugrv, "ú", "Ú", "úÚ", U, GRAVE)
        ACCENTED_KEY(ucir, "û", "Û", "ûÛ", U, I)

        MACRO_HOLD_TAP(eacugrv, ac_eacu, ac_egrv)
        MACRO_HOLD_TAP(ecirtre, ac_ecir, ac_etre)

        ac_ccdi: ac_ccdi {
            wait-ms = <0>;
            tap-ms = <0>;
            label = "ç";
            compatible = "zmk,behavior-macro";
            #binding-cells = <0>;
            bindings
                = <&macro_press &kp LALT>
                , <&macro_tap &kp C>
                , <&macro_release &kp LALT>
                ;
        };
        
        // like &mt but with macros as parameters
        ac_eacugrv: mmt {
            compatible = "zmk,behavior-hold-tap";
            #binding-cells = <2>;
            tapping-term-ms = <200>;
            quick-tap-ms = <0>;
            flavor = "tap-preferred";
            bindings = <&ac_egrv>, <&ac_eacu>;
        };
    };
};